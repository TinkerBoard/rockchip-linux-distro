## package/rknpu-fw/Config.in
```kconfig
config BR2_PACKAGE_RKNPU_FW
	bool "rknpu firmware"
	help
	  "Copy rknpu firmware and upgrade"

config BR2_PACKAGE_RKNPU_USB
	bool "rknpu upgrade firmware with usb "
	help
	  "rknpu firmware upgrade"

config BR2_PACKAGE_RKNPU_PCIE
	bool "rknpu upgrade firmware with pcie"
	help
	  "rknpu firmware upgrade"
```
